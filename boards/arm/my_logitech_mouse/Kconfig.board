## boards/arm/my_logitech_mouse/Kconfig.board
```kconfig
# Copyright (c) 2022 Nordic Semiconductor ASA
# SPDX-License-Identifier: Apache-2.0

config BOARD_MY_LOGITECH_MOUSE
	bool "My Logitech Mouse"
	depends on SOC_NRF52840_QIAA
```

## boards/arm/my_logitech_mouse/Kconfig.defconfig
```kconfig
# Copyright (c) 2022 Nordic Semiconductor ASA
# SPDX-License-Identifier: Apache-2.0

if BOARD_MY_LOGITECH_MOUSE

config BOARD
	default "my_logitech_mouse"

config BT_CTLR
   default BT

endif
```
